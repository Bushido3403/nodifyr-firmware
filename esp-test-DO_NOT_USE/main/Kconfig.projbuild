## esp-test-DO_NOT_USE/main/Kconfig.projbuild
```kconfig
menu "Nodifyr"

config NODIFYR_WIFI_SSID
    string "WiFi SSID (fallback if not in NVS)"
    default "myssid"

config NODIFYR_WIFI_PASSWORD
    string "WiFi password (fallback if not in NVS)"
    default "mypassword"

config NODIFYR_API_URL
    string "Telemetry upload URL (full path)"
    default "https://app.nodifyr.io/api/v1/telemetry"
    help
        Nodifyr ingestion endpoint. Local dev example:
        http://localhost:3000/api/v1/telemetry

config NODIFYR_CLAIM_URL
    string "Gateway claim API URL"
    default "https://app.nodifyr.io/api/v1/provision/claim"
    help
        POST endpoint to exchange a dashboard setup code for a gateway API key.

config NODIFYR_GATEWAY_API_KEY
    string "Gateway API key (Phase 1 fallback)"
    default ""
    help
        Per-gateway key from Nodifyr provisioning (ngw_...).
        Persisted to NVS on first boot. Leave empty to use SoftAP setup.

config NODIFYR_PROVISION_BUTTON_GPIO
    int "GPIO for forced provisioning (hold 5s at boot)"
    default 0
    range 0 48
    help
        Heltec PRG/BOOT button is GPIO 0. Hold at boot to enter setup mode.

config NODIFYR_UPLOAD_INTERVAL_SEC
    int "Upload interval (seconds)"
    default 60
    range 5 3600
    help
        How often to POST batched readings. 60 = 1 minute.

config NODIFYR_UPLOAD_BATCH_MAX
    int "Max readings per upload"
    default 64
    range 1 64
    help
        Must not exceed server limit (64).

endmenu
```

## esp-test-DO_NOT_USE/sdkconfig.defaults
```kconfig
CONFIG_IDF_TARGET="esp32s3"

# NimBLE observer scanner + WiFi coexistence
CONFIG_BT_ENABLED=y
CONFIG_BT_NIMBLE_ENABLED=y
CONFIG_BT_BLUEDROID_ENABLED=n
# CENTRAL + GATT client required for ESP-IDF NimBLE to compile with scan-only apps
# (observer-only / no-GATT configs leave dead references in ble_gap.c / ble_gattc.c).
# Scanning still works; MAX_CONNECTIONS=0 keeps the device from accepting connections.
CONFIG_BT_NIMBLE_ROLE_CENTRAL=y
CONFIG_BT_NIMBLE_ROLE_PERIPHERAL=n
CONFIG_BT_NIMBLE_ROLE_BROADCASTER=n
CONFIG_BT_NIMBLE_ROLE_OBSERVER=y
CONFIG_BT_NIMBLE_MAX_CONNECTIONS=0
CONFIG_BT_NIMBLE_GATT_CLIENT=y
CONFIG_ESP_COEX_ENABLED=y
CONFIG_PARTITION_TABLE_SINGLE_APP_LARGE=y

# HTTPS for telemetry upload and provisioning claim
CONFIG_MBEDTLS_CERTIFICATE_BUNDLE=y
CONFIG_MBEDTLS_CERTIFICATE_BUNDLE_DEFAULT_FULL=y

# Reliability: always self-recover, never halt on a fault
CONFIG_ESP_SYSTEM_PANIC_PRINT_REBOOT=y
CONFIG_ESP_MAIN_TASK_STACK_SIZE=8192

# Task watchdog: reboot if any core's idle task is starved (deadlock/livelock)
CONFIG_ESP_TASK_WDT_EN=y
CONFIG_ESP_TASK_WDT_INIT=y
CONFIG_ESP_TASK_WDT_TIMEOUT_S=10
CONFIG_ESP_TASK_WDT_CHECK_IDLE_TASK_CPU0=y
CONFIG_ESP_TASK_WDT_CHECK_IDLE_TASK_CPU1=y

# Interrupt watchdog: catch ISRs / critical sections that run too long
CONFIG_ESP_INT_WDT=y
CONFIG_ESP_INT_WDT_TIMEOUT_MS=800
```
