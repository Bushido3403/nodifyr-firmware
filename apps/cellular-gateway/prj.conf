## CMakeLists.txt
```
cmake_minimum_required(VERSION 3.20.0)

find_package(Zephyr REQUIRED HINTS $ENV{ZEPHYR_BASE})
project(cellular_gateway)

target_sources(app PRIVATE
	src/main.c
	src/lte.c
	src/identity.c
	src/https_client.c
	src/pairing.c
	src/telemetry.c
	src/radar_stub.c
	src/json_util.c
	src/device_config.c
	src/battery.c
)

target_include_directories(app PRIVATE src)

set(gen_dir ${CMAKE_CURRENT_BINARY_DIR}/certs)
zephyr_include_directories(${gen_dir})
generate_inc_file_for_target(
	app
	cert/isrgrootx1.pem
	${gen_dir}/isrgrootx1.pem.inc
)
```

## Kconfig
```
mainmenu "Nodifyr cellular gateway"

menu "Nodifyr cloud"

config NODIFYR_PAIRING_SECRET
	string "Factory pairing secret seed (dev only)"
	default ""
	help
	  If Settings flash has no pairing_secret, seed from this value at boot.
	  Leave empty for release builds. Production devices must be factory-
	  provisioned into Settings/NVS.

config NODIFYR_CLOUD_HOST
	string "Nodifyr API hostname"
	default "app.nodifyr.io"
	help
	  Hostname used for TLS SNI and HTTPS requests.

config NODIFYR_PAIR_PATH
	string "Pair announcement path"
	default "/api/v1/provision/pair"
	help
	  POST path for pairing announcement.

config NODIFYR_STATUS_PATH
	string "Pair status path"
	default "/api/v1/provision/pair/status"
	help
	  GET path for pairing status poll.

config NODIFYR_DEFAULT_TELEMETRY_URL
	string "Default telemetry URL"
	default "https://app.nodifyr.io/api/v1/telemetry"
	help
	  Used when approved status omits api_url.

config NODIFYR_TLS_SEC_TAG
	int "Modem TLS security tag for Nodifyr CA"
	default 42
	help
	  Security tag used when provisioning the ISRG Root X1 CA to the modem
	  and when opening TLS sockets to app.nodifyr.io.

config NODIFYR_PAIR_POLL_INTERVAL_S
	int "Pair status poll interval in seconds"
	default 45
	range 30 60
	help
	  Status poll interval while pending during the first hour.

config NODIFYR_PAIR_POLL_BACKOFF_S
	int "Pair status poll backoff interval in seconds"
	default 180
	range 120 300
	help
	  Status poll interval after the first hour of pending.

config NODIFYR_PAIR_POLL_BACKOFF_AFTER_S
	int "Seconds before pair poll backoff"
	default 3600
	help
	  After this many seconds of pending, switch to the backoff interval.

config NODIFYR_TELEMETRY_QUEUE_SIZE
	int "In-RAM telemetry queue capacity"
	default 512
	range 64 1024
	help
	  Ring buffer capacity for radar readings (~25 KB at default size).

config NODIFYR_TELEMETRY_BATCH_MAX
	int "Max readings per telemetry POST"
	default 64
	range 1 64
	help
	  Cloud accepts at most 64 readings per batch.

config NODIFYR_TELEMETRY_UPLOAD_INTERVAL_S
	int "Telemetry upload interval in seconds"
	default 30
	range 5 600
	help
	  How often NORMAL mode attempts a telemetry upload when the queue
	  is non-empty.

config NODIFYR_RADAR_STUB_INTERVAL_S
	int "Synthetic radar emit interval in seconds"
	default 15
	range 1 3600
	help
	  Interval between synthetic car.v1 detections from the radar stub.

config NODIFYR_GAP_TELEMETRY
	bool "Emit nodifyr.radar.gap.v1 on queue overflow"
	default n
	help
	  When disabled (default), a full queue overwrites the oldest reading
	  without emitting a gap summary. Enable only after nodifyr-app
	  registers nodifyr.radar.gap.v1 — unknown device_type values 400 the
	  entire batch today.

config NODIFYR_HTTP_TIMEOUT_MS
	int "HTTPS request timeout in milliseconds"
	default 30000
	range 5000 120000
	help
	  Timeout for DNS, connect, and HTTP exchange.

endmenu

module = NODIFYR
module-str = Nodifyr cellular gateway
source "$(ZEPHYR_BASE)/subsys/logging/Kconfig.template.log_config"

source "Kconfig.zephyr"
```

## sysbuild.conf
```
# Freestanding nRF9151/ns builds include TF-M via the board target.
# Thingy:91 X factory layout enables MCUboot by default (USB DFU).
# nRF9151 DK bring-up can omit MCUboot unless you enable it here.
```

## prj.conf
```kconfig
# Nodifyr cellular gateway — nRF9151 / NCS v3.4.0

CONFIG_LOG=y
CONFIG_LOG_MODE_DEFERRED=y
CONFIG_LOG_BUFFER_SIZE=4096
CONFIG_NODIFYR_LOG_LEVEL_INF=y

CONFIG_ASSERT=y
CONFIG_REBOOT=y

# Stacks / heap (HTTPS + cJSON + settings)
CONFIG_MAIN_STACK_SIZE=8192
CONFIG_SYSTEM_WORKQUEUE_STACK_SIZE=4096
CONFIG_HEAP_MEM_POOL_SIZE=32768
CONFIG_POSIX_API=y

# Modem + LTE (Hologram APN, IPv4)
CONFIG_NRF_MODEM_LIB=y
CONFIG_LTE_LINK_CONTROL=y
CONFIG_LTE_LC_PDN_MODULE=y
CONFIG_LTE_LC_PDN_DEFAULTS_OVERRIDE=y
CONFIG_LTE_LC_PDN_DEFAULT_APN="hologram"
CONFIG_LTE_LC_PDN_DEFAULT_FAM_IPV4=y
CONFIG_LTE_NETWORK_MODE_LTE_M_NBIOT=y
CONFIG_MODEM_KEY_MGMT=y
CONFIG_MODEM_INFO=y
CONFIG_AT_MONITOR=y

# Power: request PSM + eDRX (network may grant less). Outbound-only gateway.
# RPTAU ~1 h, active time ~12 s so RRC can drop after uplink.
CONFIG_LTE_LC_PSM_MODULE=y
CONFIG_LTE_PSM_REQ=y
CONFIG_LTE_PSM_REQ_RPTAU="00100001"
CONFIG_LTE_PSM_REQ_RAT="00000110"
CONFIG_LTE_LC_EDRX_MODULE=y
CONFIG_LTE_EDRX_REQ=y
# ~61 s eDRX cycle (LTE-M / NB-IoT); fine for uplink-driven traffic
CONFIG_LTE_EDRX_REQ_VALUE_LTE_M="0100"
CONFIG_LTE_EDRX_REQ_VALUE_NBIOT="0100"

# Device power management (system CONFIG_PM is unavailable on nRF9151)
CONFIG_PM_DEVICE=y

# Networking (modem offload)
CONFIG_NETWORKING=y
CONFIG_NET_NATIVE=n
CONFIG_NET_SOCKETS=y
CONFIG_NET_SOCKETS_OFFLOAD=y
CONFIG_NET_IPV4=y
CONFIG_NET_IPV6=n
CONFIG_NET_TCP=y
CONFIG_NET_UDP=y
CONFIG_DNS_RESOLVER=y
CONFIG_DNS_SERVER_IP_ADDRESSES=y
CONFIG_DNS_SERVER1="8.8.8.8"
CONFIG_HTTP_CLIENT=y

# Wall-clock for telemetry ts (epoch ms)
CONFIG_DATE_TIME=y
CONFIG_DATE_TIME_MODEM=y
CONFIG_DATE_TIME_NTP=y
CONFIG_DATE_TIME_AUTO_UPDATE=y

# Credentials persistence
CONFIG_SETTINGS=y
CONFIG_SETTINGS_NVS=y
CONFIG_NVS=y
CONFIG_FLASH=y
CONFIG_FLASH_MAP=y
CONFIG_FLASH_PAGE_LAYOUT=y
CONFIG_MPU_ALLOW_FLASH_WRITE=y

# JSON
CONFIG_CJSON_LIB=y

# Entropy for any TLS/socket needs
CONFIG_ENTROPY_GENERATOR=y

# Console
CONFIG_CONSOLE=y
CONFIG_UART_CONSOLE=y
CONFIG_SERIAL=y

# Thingy:91 X nPM1300 battery voltage (SoC estimate)
CONFIG_SENSOR=y
CONFIG_I2C=y

# Lab bring-up only: seeds Settings/NVS when flash has no pairing_secret.
# Enter this same code under Devices → Pair device on app.nodifyr.io.
# Clear or leave empty for production factory provisioning.
CONFIG_NODIFYR_PAIRING_SECRET="NODI-FYR1-DK91-BRNG"
```

## boards/nrf9151dk_nrf9151_ns.conf
```kconfig
# Board fragment for nrf9151dk/nrf9151/ns (PCA10171)

CONFIG_TFM_PROFILE_TYPE_SMALL=y

# Increase modem heap slightly for TLS + DNS
CONFIG_NRF_MODEM_LIB_SHMEM_TX_SIZE=8192
CONFIG_NRF_MODEM_LIB_SHMEM_RX_SIZE=8192
```

## boards/thingy91x_nrf9151_ns.conf
```kconfig
# Board fragment for thingy91x/nrf9151/ns (PCA20065 / Thingy:91 X)
#
# Factory static partitions give TF-M only ~32 KB and no ITS/PS areas.
# SMALL profile (used on the nRF9151 DK) fails to build here.

CONFIG_TFM_PROFILE_TYPE_MINIMAL=y

# Increase modem heap slightly for TLS + DNS
CONFIG_NRF_MODEM_LIB_SHMEM_TX_SIZE=8192
CONFIG_NRF_MODEM_LIB_SHMEM_RX_SIZE=8192
```

## src/main.c
```c
#include "nodifyr_common.h"
#include "lte.h"
#include "identity.h"
#include "pairing.h"
#include "telemetry.h"
#include "radar_stub.h"
#include "device_config.h"
#include "https_client.h"

#include <errno.h>

#include <zephyr/kernel.h>
#include <zephyr/logging/log.h>
#include <zephyr/sys/util.h>

LOG_MODULE_REGISTER(nodifyr_main, CONFIG_NODIFYR_LOG_LEVEL);

/** Cloud hard limit — detailed mode uploads as soon as the queue hits this. */
#define DETAILED_UPLOAD_THRESHOLD 64

static struct nodifyr_identity identity;
static enum nodifyr_state state = NODIFYR_STATE_BOOT;

static void enter_error(const char *reason)
{
	LOG_ERR("ERROR state: %s", reason);
	state = NODIFYR_STATE_ERROR;
}

static void enter_fatal(const char *reason)
{
	LOG_ERR("FATAL: %s", reason);
	state = NODIFYR_STATE_FATAL;
}

static void run_pairing(void)
{
	enum nodifyr_pair_result result;

	LOG_INF("PAIRING: announce + poll status");
	state = NODIFYR_STATE_PAIRING;

	while (state == NODIFYR_STATE_PAIRING) {
		result = nodifyr_pairing_step(&identity);
		switch (result) {
		case NODIFYR_PAIR_APPROVED:
			LOG_INF("Pairing complete — entering NORMAL");
			state = NODIFYR_STATE_NORMAL;
			break;
		case NODIFYR_PAIR_ERROR:
			enter_error("pairing terminal failure");
			break;
		case NODIFYR_PAIR_CONTINUE:
		default:
			LOG_INF("Pairing pending; next poll in %d s",
				nodifyr_pairing_next_poll_s());
			k_sleep(K_SECONDS(nodifyr_pairing_next_poll_s()));
			break;
		}
	}
}

/**
 * One cellular burst: POST telemetry (+ battery) and GET config on one TLS
 * session when possible.
 */
static int upload_and_refresh_config(int *upload_backoff_s)
{
	enum nodifyr_upload_result up;
	struct nodifyr_device_config cfg;
	int err;

	nodifyr_device_config_get(&cfg);

	if (cfg.upload_mode == NODIFYR_UPLOAD_SUMMARY) {
		nodifyr_telemetry_summary_flush_force();
	}

	(void)nodifyr_https_session_begin(NULL);

	up = nodifyr_telemetry_upload(&identity);
	switch (up) {
	case NODIFYR_UPLOAD_OK:
	case NODIFYR_UPLOAD_DROP:
		*upload_backoff_s = cfg.upload_interval_sec;
		break;
	case NODIFYR_UPLOAD_AUTH_ERROR:
		nodifyr_https_session_end();
		enter_error("telemetry 401/403");
		return -EACCES;
	case NODIFYR_UPLOAD_RETRY:
	default:
		*upload_backoff_s = MIN(*upload_backoff_s * 2, 300);
		LOG_WRN("Upload retry backoff %d s", *upload_backoff_s);
		break;
	}

	err = nodifyr_device_config_poll(&identity);
	nodifyr_https_session_end();

	if (err == -EACCES) {
		enter_error("config poll 401/403");
		return err;
	}

	nodifyr_device_config_get(&cfg);
	if (*upload_backoff_s <= cfg.upload_interval_sec) {
		*upload_backoff_s = cfg.upload_interval_sec;
	}

	return 0;
}

static void run_normal(void)
{
	struct nodifyr_device_config cfg;
	int64_t now_ms;
	int64_t last_cycle_ms = 0;
	int64_t due_ms;
	int64_t wait_ms;
	int upload_backoff_s;
	int err;
	bool full_batch;

	LOG_INF("NORMAL: radar stub + upload/config cycle");
	nodifyr_device_config_init();
	nodifyr_device_config_get(&cfg);
	upload_backoff_s = cfg.upload_interval_sec;

	(void)nodifyr_radar_stub_start();

	/* First cycle ASAP so dashboard config applies. */
	err = upload_and_refresh_config(&upload_backoff_s);
	if (err == -EACCES) {
		return;
	}
	last_cycle_ms = k_uptime_get();
	nodifyr_device_config_get(&cfg);
	upload_backoff_s = cfg.upload_interval_sec;

	while (state == NODIFYR_STATE_NORMAL) {
		now_ms = k_uptime_get();
		nodifyr_device_config_get(&cfg);

		due_ms = last_cycle_ms + ((int64_t)upload_backoff_s * 1000);
		wait_ms = due_ms - now_ms;
		full_batch = (cfg.upload_mode == NODIFYR_UPLOAD_DETAILED) &&
			     (nodifyr_telemetry_queued() >=
			      DETAILED_UPLOAD_THRESHOLD);

		if (!full_batch && wait_ms > 0) {
			/* Sleep until upload is due, or detailed queue fills. */
			(void)nodifyr_telemetry_wait_queued(
				DETAILED_UPLOAD_THRESHOLD, K_MSEC(wait_ms));
		}

		full_batch = (cfg.upload_mode == NODIFYR_UPLOAD_DETAILED) &&
			     (nodifyr_telemetry_queued() >=
			      DETAILED_UPLOAD_THRESHOLD);

		if (full_batch) {
			LOG_INF("Detailed queue at %u — uploading now",
				(unsigned)nodifyr_telemetry_queued());
		}

		err = upload_and_refresh_config(&upload_backoff_s);
		if (err == -EACCES) {
			continue;
		}
		last_cycle_ms = k_uptime_get();
		nodifyr_device_config_get(&cfg);
		if (upload_backoff_s <= cfg.upload_interval_sec) {
			upload_backoff_s = cfg.upload_interval_sec;
		}
	}
}

int main(void)
{
	int err;

	LOG_INF("Nodifyr cellular gateway starting");
#if IS_ENABLED(CONFIG_NODIFYR_GAP_TELEMETRY)
	LOG_WRN("Gap telemetry ENABLED — requires app nodifyr.radar.gap.v1");
#else
	LOG_INF("Gap telemetry disabled (overwrite-oldest on overflow)");
#endif

	err = nodifyr_identity_init(&identity);
	if (err) {
		enter_fatal("settings init failed");
		goto halt;
	}

	err = nodifyr_lte_connect();
	if (err) {
		enter_fatal("LTE connect failed");
		goto halt;
	}

	err = nodifyr_lte_log_network_info();
	if (err) {
		LOG_WRN("Network info / time sync incomplete: %d", err);
	}

	err = nodifyr_identity_set_imei(&identity);
	if (err) {
		enter_fatal("IMEI unavailable");
		goto halt;
	}

	err = nodifyr_telemetry_init();
	if (err) {
		enter_fatal("telemetry init failed");
		goto halt;
	}

	if (identity.has_api_key) {
		LOG_INF("Boot: api_key present — NORMAL");
		state = NODIFYR_STATE_NORMAL;
		run_normal();
	} else if (!identity.has_pairing_secret) {
		enter_fatal("no pairing_secret (factory issue)");
	} else {
		run_pairing();
		if (state == NODIFYR_STATE_NORMAL) {
			run_normal();
		}
	}

halt:
	while (1) {
		if (state == NODIFYR_STATE_ERROR || state == NODIFYR_STATE_FATAL) {
			LOG_ERR("Halted in state %d", state);
		}
		k_sleep(K_SECONDS(60));
	}

	return 0;
}
```

## src/battery.c
```c
#include "battery.h"

#include <zephyr/device.h>
#include <zephyr/drivers/sensor.h>
#include <zephyr/logging/log.h>
#include <zephyr/sys/util.h>

LOG_MODULE_REGISTER(nodifyr_batt, CONFIG_NODIFYR_LOG_LEVEL);

#if DT_NODE_HAS_STATUS(DT_NODELABEL(npm1300_charger), okay)

/* Rough LiPo OCV → SoC for Thingy:91 X pack (LP803448-class, 4.2 V full). */
struct ocv_point {
	int mv;
	uint8_t pct;
};

static const struct ocv_point ocv_table[] = {
	{ 4200, 100 },
	{ 4050, 90 },
	{ 3900, 75 },
	{ 3800, 60 },
	{ 3700, 45 },
	{ 3600, 30 },
	{ 3500, 18 },
	{ 3400, 10 },
	{ 3300, 5 },
	{ 3000, 0 },
};

static uint8_t voltage_mv_to_pct(int mv)
{
	size_t i;

	if (mv >= ocv_table[0].mv) {
		return 100;
	}
	if (mv <= ocv_table[ARRAY_SIZE(ocv_table) - 1].mv) {
		return 0;
	}

	for (i = 0; i < ARRAY_SIZE(ocv_table) - 1; i++) {
		if (mv <= ocv_table[i].mv && mv >= ocv_table[i + 1].mv) {
			int mv_hi = ocv_table[i].mv;
			int mv_lo = ocv_table[i + 1].mv;
			int pct_hi = ocv_table[i].pct;
			int pct_lo = ocv_table[i + 1].pct;
			int span = mv_hi - mv_lo;

			if (span <= 0) {
				return (uint8_t)pct_lo;
			}
			return (uint8_t)(pct_lo +
					 ((pct_hi - pct_lo) * (mv - mv_lo)) /
						 span);
		}
	}

	return 0;
}

bool nodifyr_battery_read_pct(uint8_t *pct_out)
{
	const struct device *charger =
		DEVICE_DT_GET(DT_NODELABEL(npm1300_charger));
	struct sensor_value volt;
	int err;
	int mv;

	if (!pct_out) {
		return false;
	}

	if (!device_is_ready(charger)) {
		LOG_WRN("nPM1300 charger not ready");
		return false;
	}

	err = sensor_sample_fetch(charger);
	if (err) {
		LOG_WRN("Battery sample fetch failed: %d", err);
		return false;
	}

	err = sensor_channel_get(charger, SENSOR_CHAN_GAUGE_VOLTAGE, &volt);
	if (err) {
		LOG_WRN("Battery voltage get failed: %d", err);
		return false;
	}

	/* sensor_value: val1 = volts, val2 = microvolts */
	mv = volt.val1 * 1000 + volt.val2 / 1000;
	*pct_out = voltage_mv_to_pct(mv);
	LOG_INF("Battery ~%u%% (%d mV)", *pct_out, mv);
	return true;
}

#else /* !npm1300_charger */

bool nodifyr_battery_read_pct(uint8_t *pct_out)
{
	ARG_UNUSED(pct_out);
	return false;
}

#endif
```

## src/battery.h
```c
#ifndef NODIFYR_BATTERY_H_
#define NODIFYR_BATTERY_H_

#include <stdbool.h>
#include <stdint.h>

/**
 * Read gateway battery state-of-charge estimate (0–100).
 * Thingy:91 X: nPM1300 charger voltage mapped to a LiPo curve.
 * Other boards: returns false (omit battery_pct from uplink).
 */
bool nodifyr_battery_read_pct(uint8_t *pct_out);

#endif /* NODIFYR_BATTERY_H_ */
```

## src/device_config.c
```c
#include "device_config.h"
#include "https_client.h"
#include "json_util.h"
#include "identity.h"

#include <zephyr/kernel.h>
#include <zephyr/logging/log.h>
#include <zephyr/settings/settings.h>

#include <cJSON.h>

#include <errno.h>
#include <stdio.h>
#include <stdlib.h>
#include <string.h>

LOG_MODULE_REGISTER(nodifyr_cfg, CONFIG_NODIFYR_LOG_LEVEL);

/* Match nodifyr-app DEFAULT_DEVICE_CONFIG (mode + interval only). */
#define DEF_UPLOAD_INTERVAL_S 60

static struct nodifyr_device_config cfg;
static struct k_mutex cfg_lock;

static void apply_defaults(struct nodifyr_device_config *c)
{
	c->upload_mode = NODIFYR_UPLOAD_DETAILED;
	c->upload_interval_sec = DEF_UPLOAD_INTERVAL_S;
	c->version = 0;
	c->have_version = false;
}

static int clamp_int(int v, int lo, int hi)
{
	if (v < lo) {
		return lo;
	}
	if (v > hi) {
		return hi;
	}
	return v;
}

static int settings_set(const char *name, size_t len, settings_read_cb read_cb,
			void *cb_arg)
{
	const char *next;
	char buf[16];
	int err;

	if (settings_name_steq(name, "ver", &next) && !next) {
		if (len >= sizeof(buf)) {
			return -ENOMEM;
		}
		memset(buf, 0, sizeof(buf));
		err = read_cb(cb_arg, buf, len);
		if (err < 0) {
			return err;
		}
		buf[len] = '\0';
		cfg.version = (int)strtol(buf, NULL, 10);
		cfg.have_version = true;
		return 0;
	}

	return -ENOENT;
}

SETTINGS_STATIC_HANDLER_DEFINE(nodifyr_cfg, "nodifyr_cfg", NULL, settings_set,
			       NULL, NULL);

static int persist_version(int version)
{
	char buf[16];
	int n;
	int err;

	n = snprintk(buf, sizeof(buf), "%d", version);
	if (n <= 0 || n >= (int)sizeof(buf)) {
		return -EINVAL;
	}

	err = settings_save_one("nodifyr_cfg/ver", buf, (size_t)n);
	if (err) {
		LOG_ERR("Failed to persist cfg_ver: %d", err);
	}
	return err;
}

static int parse_and_apply(const cJSON *root, int version)
{
	const cJSON *config;
	const char *mode;
	struct nodifyr_device_config next;
	int v;

	config = cJSON_GetObjectItemCaseSensitive(root, "config");
	if (!cJSON_IsObject(config)) {
		LOG_ERR("Config response missing config object");
		return -EINVAL;
	}

	next = cfg;
	next.version = version;
	next.have_version = true;

	mode = nodifyr_json_get_string(config, "upload_mode");
	if (mode) {
		if (strcmp(mode, "summary") == 0) {
			next.upload_mode = NODIFYR_UPLOAD_SUMMARY;
		} else {
			next.upload_mode = NODIFYR_UPLOAD_DETAILED;
		}
	}

	if (nodifyr_json_get_int(config, "upload_interval_sec", &v)) {
		next.upload_interval_sec = clamp_int(v, 10, 86400);
	}

	k_mutex_lock(&cfg_lock, K_FOREVER);
	cfg = next;
	k_mutex_unlock(&cfg_lock);

	(void)persist_version(version);

	LOG_INF("Config v%d applied: mode=%s interval=%ds", version,
		next.upload_mode == NODIFYR_UPLOAD_SUMMARY ? "summary" :
							     "detailed",
		next.upload_interval_sec);

	return 0;
}

void nodifyr_device_config_init(void)
{
	k_mutex_init(&cfg_lock);
	apply_defaults(&cfg);
	(void)settings_load_subtree("nodifyr_cfg");
	LOG_INF("Runtime config defaults ready (version %s%d)",
		cfg.have_version ? "" : "unset/",
		cfg.have_version ? cfg.version : 0);
}

void nodifyr_device_config_get(struct nodifyr_device_config *out)
{
	if (!out) {
		return;
	}

	k_mutex_lock(&cfg_lock, K_FOREVER);
	*out = cfg;
	k_mutex_unlock(&cfg_lock);
}

int nodifyr_device_config_poll(const struct nodifyr_identity *id)
{
	char query[48];
	char api_hdr[96];
	const char *headers[3];
	struct nodifyr_http_response resp;
	cJSON *root;
	const cJSON *unchanged;
	const cJSON *ver_item;
	int version;
	int err;
	struct nodifyr_device_config snap;

	if (!id || !id->has_api_key) {
		return -EINVAL;
	}

	nodifyr_device_config_get(&snap);

	if (snap.have_version) {
		snprintk(query, sizeof(query), "since=%d", snap.version);
	} else {
		query[0] = '\0';
	}

	snprintk(api_hdr, sizeof(api_hdr), "X-Api-Key: %s\r\n", id->api_key);
	headers[0] = api_hdr;
	headers[1] = NULL;

	err = nodifyr_https_request(NULL, "GET", "/api/v1/config",
				    query[0] ? query : NULL, NULL, headers,
				    &resp);
	if (err) {
		return err;
	}

	if (resp.status_code == 401 || resp.status_code == 403) {
		LOG_ERR("Config poll auth HTTP %d", resp.status_code);
		return -EACCES;
	}

	if (resp.status_code == 429 || resp.status_code >= 500) {
		LOG_WRN("Config poll HTTP %d", resp.status_code);
		return -EAGAIN;
	}

	if (resp.status_code < 200 || resp.status_code >= 300 || !resp.body) {
		LOG_WRN("Config poll HTTP %d", resp.status_code);
		return -EIO;
	}

	root = cJSON_ParseWithLength(resp.body, resp.body_len);
	if (!root) {
		LOG_ERR("Config JSON parse failed");
		return -EINVAL;
	}

	unchanged = cJSON_GetObjectItemCaseSensitive(root, "unchanged");
	if (cJSON_IsTrue(unchanged)) {
		LOG_DBG("Config unchanged (v%d)", snap.version);
		cJSON_Delete(root);
		return 0;
	}

	ver_item = cJSON_GetObjectItemCaseSensitive(root, "version");
	if (!cJSON_IsNumber(ver_item)) {
		LOG_ERR("Config response missing version");
		cJSON_Delete(root);
		return -EINVAL;
	}
	version = ver_item->valueint;

	err = parse_and_apply(root, version);
	cJSON_Delete(root);
	return err;
}
```

## src/device_config.h
```c
#ifndef NODIFYR_DEVICE_CONFIG_H_
#define NODIFYR_DEVICE_CONFIG_H_

#include "nodifyr_common.h"

#include <stdbool.h>
#include <stdint.h>

enum nodifyr_upload_mode {
	NODIFYR_UPLOAD_DETAILED = 0,
	NODIFYR_UPLOAD_SUMMARY,
};

/**
 * Runtime config from GET /api/v1/config (dashboard → cellular).
 * Fetched when the device uploads telemetry (same cadence).
 */
struct nodifyr_device_config {
	enum nodifyr_upload_mode upload_mode;
	int upload_interval_sec;
	int version;
	bool have_version;
};

void nodifyr_device_config_init(void);

/** Snapshot of the currently applied config (safe to call from any thread). */
void nodifyr_device_config_get(struct nodifyr_device_config *out);

/**
 * GET /api/v1/config?since=<version>. Persists + applies when version changes.
 * Returns 0 on success (including unchanged), negative on transport error,
 * -EACCES on 401/403.
 */
int nodifyr_device_config_poll(const struct nodifyr_identity *id);

#endif /* NODIFYR_DEVICE_CONFIG_H_ */
```

## src/https_client.c
```c
#include "https_client.h"

#include <zephyr/kernel.h>
#include <zephyr/logging/log.h>
#include <zephyr/net/socket.h>
#include <zephyr/net/http/client.h>
#include <zephyr/net/tls_credentials.h>

#include <stdio.h>
#include <string.h>
#include <strings.h>
#include <errno.h>
#include <stdlib.h>

LOG_MODULE_REGISTER(nodifyr_https, CONFIG_NODIFYR_LOG_LEVEL);

#define RECV_BUF_SIZE	4096
#define BODY_BUF_SIZE	4096

static uint8_t recv_buf[RECV_BUF_SIZE];
static char body_buf[BODY_BUF_SIZE];
static size_t body_len;
static int http_status;
static int retry_after_s;

static int session_sock = -1;
static char session_host[64];

struct resp_ctx {
	bool done;
};

static int parse_retry_after(const char *headers, size_t headers_len)
{
	const char *p;
	const char *end;
	char key[] = "retry-after:";

	if (!headers || headers_len == 0) {
		return 0;
	}

	end = headers + headers_len;
	p = headers;
	while (p + sizeof(key) < end) {
		if (strncasecmp(p, key, sizeof(key) - 1) == 0) {
			p += sizeof(key) - 1;
			while (p < end && (*p == ' ' || *p == '\t')) {
				p++;
			}
			return atoi(p);
		}
		while (p < end && *p != '\n') {
			p++;
		}
		if (p < end) {
			p++;
		}
	}

	return 0;
}

static int response_cb(struct http_response *rsp, enum http_final_call final_data,
		       void *user_data)
{
	struct resp_ctx *ctx = user_data;
	size_t copy;

	if (rsp->http_status_code > 0) {
		http_status = rsp->http_status_code;
	}

	/* NCS/Zephyr http_response no longer exposes header_start; headers
	 * occupy recv_buf until body_frag_start when both are present.
	 */
	if (retry_after_s == 0 && rsp->recv_buf && rsp->data_len > 0) {
		size_t header_len = rsp->data_len;

		if (rsp->body_frag_start) {
			if (rsp->body_frag_start > rsp->recv_buf) {
				header_len = (size_t)(rsp->body_frag_start -
						      rsp->recv_buf);
			} else {
				header_len = 0;
			}
		}

		if (header_len > 0) {
			retry_after_s = parse_retry_after(
				(const char *)rsp->recv_buf, header_len);
		}
	}

	if (rsp->body_frag_start && rsp->body_frag_len > 0) {
		copy = rsp->body_frag_len;
		if (body_len + copy >= sizeof(body_buf)) {
			copy = sizeof(body_buf) - 1 - body_len;
		}
		if (copy > 0) {
			memcpy(&body_buf[body_len], rsp->body_frag_start, copy);
			body_len += copy;
			body_buf[body_len] = '\0';
		}
	}

	if (final_data == HTTP_DATA_FINAL) {
		ctx->done = true;
	}

	return 0;
}

static int setup_tls_socket(int sock, const char *hostname)
{
	int err;
	int verify = TLS_PEER_VERIFY_REQUIRED;
	sec_tag_t sec_tag_list[] = { CONFIG_NODIFYR_TLS_SEC_TAG };

	err = zsock_setsockopt(sock, SOL_TLS, TLS_PEER_VERIFY, &verify,
			       sizeof(verify));
	if (err) {
		LOG_ERR("TLS_PEER_VERIFY failed: %d", errno);
		return -errno;
	}

	err = zsock_setsockopt(sock, SOL_TLS, TLS_SEC_TAG_LIST, sec_tag_list,
			       sizeof(sec_tag_list));
	if (err) {
		LOG_ERR("TLS_SEC_TAG_LIST failed: %d", errno);
		return -errno;
	}

	err = zsock_setsockopt(sock, SOL_TLS, TLS_HOSTNAME, hostname,
			       strlen(hostname));
	if (err) {
		LOG_ERR("TLS_HOSTNAME failed: %d", errno);
		return -errno;
	}

	return 0;
}

static int connect_host(const char *hostname, uint16_t port)
{
	int err;
	int sock = -1;
	struct zsock_addrinfo hints = { 0 };
	struct zsock_addrinfo *res = NULL;
	char port_str[8];

	hints.ai_family = AF_INET;
	hints.ai_socktype = SOCK_STREAM;

	snprintk(port_str, sizeof(port_str), "%u", port);

	err = zsock_getaddrinfo(hostname, port_str, &hints, &res);
	if (err) {
		LOG_ERR("DNS %s failed: %d", hostname, err);
		return -EIO;
	}

	sock = zsock_socket(res->ai_family, SOCK_STREAM, IPPROTO_TLS_1_2);
	if (sock < 0) {
		LOG_ERR("socket failed: %d", errno);
		err = -errno;
		goto out;
	}

	err = setup_tls_socket(sock, hostname);
	if (err) {
		zsock_close(sock);
		sock = err;
		goto out;
	}

	err = zsock_connect(sock, res->ai_addr, res->ai_addrlen);
	if (err) {
		LOG_ERR("connect %s:%u failed: %d", hostname, port, errno);
		zsock_close(sock);
		sock = -errno;
		goto out;
	}

out:
	zsock_freeaddrinfo(res);
	return sock;
}

static enum http_method method_from_str(const char *method)
{
	if (method && strcmp(method, "POST") == 0) {
		return HTTP_POST;
	}
	return HTTP_GET;
}

void nodifyr_https_session_end(void)
{
	if (session_sock >= 0) {
		zsock_close(session_sock);
		session_sock = -1;
	}
	session_host[0] = '\0';
}

int nodifyr_https_session_begin(const char *host)
{
	int sock;

	if (!host || host[0] == '\0') {
		host = CONFIG_NODIFYR_CLOUD_HOST;
	}

	nodifyr_https_session_end();

	sock = connect_host(host, 443);
	if (sock < 0) {
		return sock;
	}

	if (strlen(host) >= sizeof(session_host)) {
		zsock_close(sock);
		return -ENOMEM;
	}

	session_sock = sock;
	strcpy(session_host, host);
	LOG_DBG("TLS session open to %s", session_host);
	return 0;
}

int nodifyr_https_request(const char *host,
			  const char *method,
			  const char *path,
			  const char *query,
			  const char *body,
			  const char *const *extra_headers,
			  struct nodifyr_http_response *resp)
{
	int sock;
	int err;
	bool owned_sock = false;
	struct http_request req = { 0 };
	struct resp_ctx ctx = { 0 };
	char url[256];
	const char *const *headers = extra_headers;

	if (!method || !path || !resp) {
		return -EINVAL;
	}

	if (!host || host[0] == '\0') {
		host = CONFIG_NODIFYR_CLOUD_HOST;
	}

	if (query && query[0] != '\0') {
		err = snprintk(url, sizeof(url), "%s?%s", path, query);
	} else {
		err = snprintk(url, sizeof(url), "%s", path);
	}
	if (err < 0 || err >= (int)sizeof(url)) {
		return -ENOMEM;
	}

	body_len = 0;
	body_buf[0] = '\0';
	http_status = 0;
	retry_after_s = 0;
	memset(resp, 0, sizeof(*resp));

	LOG_INF("%s https://%s%s", method, host, url);

	if (session_sock >= 0 && strcmp(session_host, host) == 0) {
		sock = session_sock;
	} else {
		sock = connect_host(host, 443);
		if (sock < 0) {
			return sock;
		}
		owned_sock = true;
	}

	/* Build header list; append keep-alive when reusing a TLS session. */
	{
		static const char *merged[8];
		int n = 0;

		if (headers) {
			while (headers[n] != NULL && n < 6) {
				merged[n] = headers[n];
				n++;
			}
		} else if (body) {
			merged[n++] = "Content-Type: application/json\r\n";
		}

		if (!owned_sock) {
			merged[n++] = "Connection: keep-alive\r\n";
		}
		merged[n] = NULL;
		headers = merged;
	}

	req.method = method_from_str(method);
	req.url = url;
	req.host = host;
	req.protocol = "HTTP/1.1";
	req.response = response_cb;
	req.recv_buf = recv_buf;
	req.recv_buf_len = sizeof(recv_buf);
	req.header_fields = (const char **)headers;

	if (body) {
		req.payload = body;
		req.payload_len = strlen(body);
	}

	err = http_client_req(sock, &req, CONFIG_NODIFYR_HTTP_TIMEOUT_MS, &ctx);
	if (owned_sock) {
		zsock_close(sock);
	}

	if (err < 0) {
		LOG_ERR("http_client_req: %d", err);
		if (!owned_sock) {
			/* Session likely broken; drop it. */
			nodifyr_https_session_end();
		}
		return err;
	}

	resp->status_code = http_status;
	resp->retry_after_s = retry_after_s;
	resp->body = body_buf;
	resp->body_len = body_len;

	LOG_INF("HTTP %d (%u body bytes)", http_status, (unsigned)body_len);
	return 0;
}
```

## src/https_client.h
```c
#ifndef NODIFYR_HTTPS_CLIENT_H_
#define NODIFYR_HTTPS_CLIENT_H_

#include <stddef.h>
#include <stdint.h>
#include <stdbool.h>

struct nodifyr_http_response {
	int status_code;
	int retry_after_s;
	char *body;
	size_t body_len;
};

/**
 * Open a persistent TLS session to host:443 (NULL = CONFIG_NODIFYR_CLOUD_HOST).
 * Use with nodifyr_https_request() then nodifyr_https_session_end().
 * Saves a second handshake when upload + config share one radio burst.
 */
int nodifyr_https_session_begin(const char *host);

/** Close the session opened by nodifyr_https_session_begin(). */
void nodifyr_https_session_end(void);

/**
 * Perform HTTPS GET or POST to host:443.
 * If a session is open to the same host, reuses that TLS connection.
 * @param host Hostname for DNS/SNI; NULL uses CONFIG_NODIFYR_CLOUD_HOST
 * @param method "GET" or "POST"
 * @param path URL path beginning with '/'
 * @param query Optional query string without leading '?', or NULL
 * @param body Optional request body, or NULL
 * @param extra_headers NULL-terminated list of "Header: value" strings, or NULL
 * @param resp Filled on success; body points into internal buffer valid until next call
 */
int nodifyr_https_request(const char *host,
			  const char *method,
			  const char *path,
			  const char *query,
			  const char *body,
			  const char *const *extra_headers,
			  struct nodifyr_http_response *resp);

#endif /* NODIFYR_HTTPS_CLIENT_H_ */
```

## src/identity.c
```c
#include "identity.h"

#include <zephyr/kernel.h>
#include <zephyr/logging/log.h>
#include <zephyr/settings/settings.h>

#include <modem/modem_info.h>

#include <stdio.h>
#include <string.h>
#include <errno.h>

LOG_MODULE_REGISTER(nodifyr_id, CONFIG_NODIFYR_LOG_LEVEL);

static struct nodifyr_identity *load_target;

static int settings_set(const char *name, size_t len, settings_read_cb read_cb,
			void *cb_arg)
{
	int err;
	const char *next;
	char *dest = NULL;
	size_t dest_size = 0;

	if (!load_target) {
		return -EINVAL;
	}

	if (settings_name_steq(name, "pairing_secret", &next) && !next) {
		dest = load_target->pairing_secret;
		dest_size = sizeof(load_target->pairing_secret);
	} else if (settings_name_steq(name, "api_key", &next) && !next) {
		dest = load_target->api_key;
		dest_size = sizeof(load_target->api_key);
	} else if (settings_name_steq(name, "api_url", &next) && !next) {
		dest = load_target->api_url;
		dest_size = sizeof(load_target->api_url);
	} else {
		return -ENOENT;
	}

	if (len >= dest_size) {
		return -ENOMEM;
	}

	memset(dest, 0, dest_size);
	err = read_cb(cb_arg, dest, len);
	if (err < 0) {
		return err;
	}
	dest[len] = '\0';

	return 0;
}

SETTINGS_STATIC_HANDLER_DEFINE(nodifyr, "nodifyr", NULL, settings_set, NULL,
			       NULL);

void nodifyr_log_trunc_secret(const char *label, const char *secret)
{
	size_t n;

	if (!secret || secret[0] == '\0') {
		LOG_INF("%s: <empty>", label);
		return;
	}

	n = strlen(secret);
	if (n <= 4) {
		LOG_INF("%s: ****", label);
		return;
	}

	LOG_INF("%s: ...%s", label, &secret[n - 4]);
}

void nodifyr_log_trunc_api_key(const char *api_key)
{
	size_t n;

	if (!api_key || api_key[0] == '\0') {
		LOG_INF("api_key: <empty>");
		return;
	}

	n = strlen(api_key);
	if (n <= 7) {
		LOG_INF("api_key: ngw_...");
		return;
	}

	LOG_INF("api_key: ngw_...%s", &api_key[n - 3]);
}

static int seed_pairing_secret_if_needed(struct nodifyr_identity *id)
{
	const char *seed = CONFIG_NODIFYR_PAIRING_SECRET;
	int err;

	if (id->pairing_secret[0] != '\0') {
		return 0;
	}

	if (seed[0] == '\0') {
		return 0;
	}

	if (strlen(seed) >= sizeof(id->pairing_secret)) {
		LOG_ERR("CONFIG_NODIFYR_PAIRING_SECRET too long");
		return -EINVAL;
	}

	LOG_WRN("Seeding pairing_secret from Kconfig (dev only)");
	strncpy(id->pairing_secret, seed, sizeof(id->pairing_secret) - 1);
	id->pairing_secret[sizeof(id->pairing_secret) - 1] = '\0';

	err = settings_save_one("nodifyr/pairing_secret", id->pairing_secret,
				strlen(id->pairing_secret));
	if (err) {
		LOG_ERR("Failed to persist seeded pairing_secret: %d", err);
		return err;
	}

	return 0;
}

int nodifyr_identity_init(struct nodifyr_identity *id)
{
	int err;

	memset(id, 0, sizeof(*id));

	err = settings_subsys_init();
	if (err) {
		LOG_ERR("settings_subsys_init: %d", err);
		return err;
	}

	return nodifyr_identity_load(id);
}

int nodifyr_identity_load(struct nodifyr_identity *id)
{
	int err;

	load_target = id;
	err = settings_load_subtree("nodifyr");
	load_target = NULL;
	if (err) {
		LOG_ERR("settings_load_subtree: %d", err);
		return err;
	}

	err = seed_pairing_secret_if_needed(id);
	if (err) {
		return err;
	}

	id->has_pairing_secret = id->pairing_secret[0] != '\0';
	id->has_api_key = id->api_key[0] != '\0';

	if (!id->has_api_key && id->api_url[0] == '\0') {
		strncpy(id->api_url, CONFIG_NODIFYR_DEFAULT_TELEMETRY_URL,
			sizeof(id->api_url) - 1);
	}

	nodifyr_log_trunc_secret("pairing_secret", id->pairing_secret);
	if (id->has_api_key) {
		nodifyr_log_trunc_api_key(id->api_key);
		LOG_INF("api_url: %s", id->api_url);
	} else {
		LOG_INF("api_key: <none>");
	}

	return 0;
}

int nodifyr_identity_set_imei(struct nodifyr_identity *id)
{
	int err;
	char imei[32];

	err = modem_info_init();
	if (err) {
		LOG_ERR("modem_info_init: %d", err);
		return err;
	}

	err = modem_info_string_get(MODEM_INFO_IMEI, imei, sizeof(imei));
	if (err < 0) {
		LOG_ERR("IMEI read failed: %d", err);
		return err;
	}

	err = snprintk(id->hardware_id, sizeof(id->hardware_id), "nrf-%s", imei);
	if (err < 0 || err >= (int)sizeof(id->hardware_id)) {
		return -ENOMEM;
	}

	LOG_INF("hardware_id: %s", id->hardware_id);
	return 0;
}

int nodifyr_identity_save_credentials(struct nodifyr_identity *id,
				      const char *api_key,
				      const char *api_url)
{
	int err;

	if (!api_key || api_key[0] == '\0') {
		return -EINVAL;
	}

	if (strlen(api_key) >= sizeof(id->api_key)) {
		return -ENOMEM;
	}

	strncpy(id->api_key, api_key, sizeof(id->api_key) - 1);
	id->api_key[sizeof(id->api_key) - 1] = '\0';

	if (api_url && api_url[0] != '\0') {
		if (strlen(api_url) >= sizeof(id->api_url)) {
			return -ENOMEM;
		}
		strncpy(id->api_url, api_url, sizeof(id->api_url) - 1);
		id->api_url[sizeof(id->api_url) - 1] = '\0';
	} else if (id->api_url[0] == '\0') {
		strncpy(id->api_url, CONFIG_NODIFYR_DEFAULT_TELEMETRY_URL,
			sizeof(id->api_url) - 1);
	}

	/* Write-before-continue: persist before returning to NORMAL. */
	err = settings_save_one("nodifyr/api_key", id->api_key,
				strlen(id->api_key));
	if (err) {
		LOG_ERR("Failed to save api_key: %d", err);
		return err;
	}

	err = settings_save_one("nodifyr/api_url", id->api_url,
				strlen(id->api_url));
	if (err) {
		LOG_ERR("Failed to save api_url: %d", err);
		return err;
	}

	id->has_api_key = true;
	LOG_INF("Persisted API credentials");
	nodifyr_log_trunc_api_key(id->api_key);
	LOG_INF("api_url: %s", id->api_url);
	return 0;
}
```

## src/identity.h
```c
#ifndef NODIFYR_IDENTITY_H_
#define NODIFYR_IDENTITY_H_

#include "nodifyr_common.h"

int nodifyr_identity_init(struct nodifyr_identity *id);
int nodifyr_identity_load(struct nodifyr_identity *id);
int nodifyr_identity_set_imei(struct nodifyr_identity *id);
int nodifyr_identity_save_credentials(struct nodifyr_identity *id,
				      const char *api_key,
				      const char *api_url);

void nodifyr_log_trunc_secret(const char *label, const char *secret);
void nodifyr_log_trunc_api_key(const char *api_key);

#endif /* NODIFYR_IDENTITY_H_ */
```

## src/json_util.c
```c
#include "json_util.h"

#include <string.h>

const char *nodifyr_json_get_string(const cJSON *obj, const char *key)
{
	const cJSON *item;

	if (!obj || !key) {
		return NULL;
	}

	item = cJSON_GetObjectItemCaseSensitive(obj, key);
	if (!cJSON_IsString(item) || item->valuestring == NULL) {
		return NULL;
	}

	return item->valuestring;
}

bool nodifyr_json_get_bool(const cJSON *obj, const char *key, bool *out)
{
	const cJSON *item;

	if (!obj || !key || !out) {
		return false;
	}

	item = cJSON_GetObjectItemCaseSensitive(obj, key);
	if (!cJSON_IsBool(item)) {
		return false;
	}

	*out = cJSON_IsTrue(item);
	return true;
}

bool nodifyr_json_get_int(const cJSON *obj, const char *key, int *out)
{
	const cJSON *item;

	if (!obj || !key || !out) {
		return false;
	}

	item = cJSON_GetObjectItemCaseSensitive(obj, key);
	if (!cJSON_IsNumber(item)) {
		return false;
	}

	*out = item->valueint;
	return true;
}
```

## src/json_util.h
```c
#ifndef NODIFYR_JSON_UTIL_H_
#define NODIFYR_JSON_UTIL_H_

#include <cJSON.h>
#include <stdbool.h>

const char *nodifyr_json_get_string(const cJSON *obj, const char *key);
bool nodifyr_json_get_bool(const cJSON *obj, const char *key, bool *out);
bool nodifyr_json_get_int(const cJSON *obj, const char *key, int *out);

#endif /* NODIFYR_JSON_UTIL_H_ */
```

## src/lte.c
```c
#include "lte.h"

#include <zephyr/kernel.h>
#include <zephyr/logging/log.h>
#include <zephyr/net/net_ip.h>

#include <modem/nrf_modem_lib.h>
#include <modem/lte_lc.h>
#include <modem/modem_key_mgmt.h>
#include <modem/modem_info.h>
#include <date_time.h>

#include <string.h>
#include <stdio.h>
#include <errno.h>

LOG_MODULE_REGISTER(nodifyr_lte, CONFIG_NODIFYR_LOG_LEVEL);

static K_SEM_DEFINE(lte_connected, 0, 1);
static volatile bool connected;

static const char ca_certificate[] = {
#include "isrgrootx1.pem.inc"
};

static int certificate_provision(void)
{
	int err;
	bool exists;

	err = modem_key_mgmt_exists(CONFIG_NODIFYR_TLS_SEC_TAG,
				    MODEM_KEY_MGMT_CRED_TYPE_CA_CHAIN,
				    &exists);
	if (err) {
		LOG_ERR("CA exists check failed: %d", err);
		return err;
	}

	if (exists) {
		err = modem_key_mgmt_cmp(CONFIG_NODIFYR_TLS_SEC_TAG,
					 MODEM_KEY_MGMT_CRED_TYPE_CA_CHAIN,
					 ca_certificate,
					 sizeof(ca_certificate));
		if (!err) {
			LOG_INF("TLS CA already provisioned (tag %d)",
				CONFIG_NODIFYR_TLS_SEC_TAG);
			return 0;
		}
		LOG_INF("TLS CA mismatch; rewriting");
	}

	err = modem_key_mgmt_write(CONFIG_NODIFYR_TLS_SEC_TAG,
				   MODEM_KEY_MGMT_CRED_TYPE_CA_CHAIN,
				   ca_certificate,
				   sizeof(ca_certificate));
	if (err) {
		LOG_ERR("CA provision failed: %d", err);
		return err;
	}

	LOG_INF("Provisioned ISRG Root X1 to modem (tag %d)",
		CONFIG_NODIFYR_TLS_SEC_TAG);
	return 0;
}

static void mark_connected(void)
{
	if (!connected) {
		connected = true;
		k_sem_give(&lte_connected);
	}
}

static void lte_handler(const struct lte_lc_evt *const evt)
{
	switch (evt->type) {
	case LTE_LC_EVT_NW_REG_STATUS:
		if ((evt->nw_reg_status != LTE_LC_NW_REG_REGISTERED_HOME) &&
		    (evt->nw_reg_status != LTE_LC_NW_REG_REGISTERED_ROAMING)) {
			if (connected) {
				LOG_WRN("LTE registration lost (%d)",
					evt->nw_reg_status);
			}
			connected = false;
			break;
		}
		LOG_INF("Network registered (%s)",
			evt->nw_reg_status == LTE_LC_NW_REG_REGISTERED_HOME ?
				"home" : "roaming");
		/* PDN usually follows registration; unblock connect wait. */
		mark_connected();
		break;

	case LTE_LC_EVT_RRC_UPDATE:
		LOG_DBG("RRC %s",
			evt->rrc_mode == LTE_LC_RRC_MODE_CONNECTED ?
				"connected" : "idle");
		break;

	case LTE_LC_EVT_PSM_UPDATE:
		LOG_INF("PSM: TAU %d s, active time %d s", evt->psm_cfg.tau,
			evt->psm_cfg.active_time);
		break;

	case LTE_LC_EVT_EDRX_UPDATE:
		LOG_INF("eDRX: mode %d, interval %d ms", evt->edrx_cfg.mode,
			(int)(evt->edrx_cfg.edrx * 1000.0f));
		break;

	case LTE_LC_EVT_PDN:
		switch (evt->pdn.type) {
		case LTE_LC_EVT_PDN_ACTIVATED:
			LOG_INF("PDN activated (cid %d)", evt->pdn.cid);
			mark_connected();
			break;
		case LTE_LC_EVT_PDN_DEACTIVATED:
			LOG_WRN("PDN deactivated (cid %d)", evt->pdn.cid);
			connected = false;
			break;
		default:
			break;
		}
		break;

	default:
		break;
	}
}

bool nodifyr_lte_is_connected(void)
{
	return connected;
}

int nodifyr_lte_wait_time(int timeout_ms)
{
	int64_t now_ms = 0;
	int64_t deadline = k_uptime_get() + timeout_ms;
	int err;

	while (k_uptime_get() < deadline) {
		err = date_time_now(&now_ms);
		if (!err && now_ms > 0) {
			LOG_INF("Wall clock ready: %lld ms", (long long)now_ms);
			return 0;
		}
		k_sleep(K_SECONDS(2));
	}

	LOG_ERR("Timed out waiting for date_time");
	return -ETIMEDOUT;
}

int nodifyr_lte_log_network_info(void)
{
	int err;
	char buf[128];

	err = modem_info_init();
	if (err) {
		LOG_WRN("modem_info_init: %d", err);
	} else {
		err = modem_info_string_get(MODEM_INFO_IMEI, buf, sizeof(buf));
		if (err >= 0) {
			size_t n = strlen(buf);

			if (n > 4) {
				LOG_INF("IMEI ...%s", &buf[n - 4]);
			} else {
				LOG_INF("IMEI available");
			}
		}

		err = modem_info_string_get(MODEM_INFO_IP_ADDRESS, buf, sizeof(buf));
		if (err >= 0) {
			LOG_INF("IP %s", buf);
		}
	}

	return nodifyr_lte_wait_time(120000);
}

int nodifyr_lte_connect(void)
{
	int err;

	LOG_INF("Initializing modem library");
	err = nrf_modem_lib_init();
	if (err) {
		LOG_ERR("nrf_modem_lib_init: %d", err);
		return err;
	}

	LOG_INF("Provisioning TLS CA (modem offline)");
	err = certificate_provision();
	if (err) {
		return err;
	}

	LOG_INF("Connecting LTE (APN hologram, IPv4)");
	err = lte_lc_connect_async(lte_handler);
	if (err) {
		LOG_ERR("lte_lc_connect_async: %d", err);
		return err;
	}

	err = k_sem_take(&lte_connected, K_MINUTES(5));
	if (err) {
		LOG_ERR("Timed out waiting for LTE registration/PDN");
		return -ETIMEDOUT;
	}

	LOG_INF("LTE connected");
	return 0;
}
```

## src/lte.h
```c
#ifndef NODIFYR_LTE_H_
#define NODIFYR_LTE_H_

#include <stdbool.h>
#include <stdint.h>

/** Initialize modem, provision TLS CA offline, attach LTE, wait for PDN/IP. */
int nodifyr_lte_connect(void);

/** True when registered with an active PDN. */
bool nodifyr_lte_is_connected(void);

/** Log IPv4, DNS, truncated IMEI, and wait for date_time sync. */
int nodifyr_lte_log_network_info(void);

/** Block until date_time reports a valid wall clock (or timeout). */
int nodifyr_lte_wait_time(int timeout_ms);

#endif /* NODIFYR_LTE_H_ */
```
